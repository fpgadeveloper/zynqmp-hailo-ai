## PetaLinux/bsp/pynqzu/project-spec/meta-user/conf/layer.conf
```bitbake
# We have a conf and classes directory, add to BBPATH
BBPATH .= ":${LAYERDIR}"

# We have recipes-* directories, add to BBFILES
BBFILES += "${LAYERDIR}/recipes-*/*/*.bb \
	${LAYERDIR}/recipes-*/*/*.bbappend"

# Hailo (meta-hailo to be aligned with Hailo releases)
BBFILES += "${LAYERDIR}/meta-*/*/*/*/*.bb \
	${LAYERDIR}/meta-*/*/*/*/*.bbappend"


BBFILE_COLLECTIONS += "meta-user"
BBFILE_PATTERN_meta-user = "^${LAYERDIR}/"
BBFILE_PRIORITY_meta-user = "7"
LAYERSERIES_COMPAT_meta-user = "honister"
```

## PetaLinux/bsp/zcu106/project-spec/meta-user/meta-hailo/meta-hailo-accelerator/conf/layer.conf
```bitbake
# We have a conf and classes directory, add to BBPATH
BBPATH .= ":${LAYERDIR}"

# We have recipes-* directories, add to BBFILES
BBFILES += "${LAYERDIR}/recipes-*/*/*.bb \
            ${LAYERDIR}/recipes-*/*/*.bbappend"

BBFILE_COLLECTIONS += "meta-hailo-accelerator"
BBFILE_PATTERN_meta-hailo-accelerator = "^${LAYERDIR}/"
BBFILE_PRIORITY_meta-hailo-accelerator = "8"

LICENSE_PATH = "${LAYERDIR}/licenses/"

LAYERDEPENDS_meta-hailo-accelerator = "core"
LAYERSERIES_COMPAT_meta-hailo-accelerator = "honister"
```

## PetaLinux/bsp/zcu106/project-spec/meta-user/meta-hailo/meta-hailo-libhailort/conf/layer.conf
```bitbake
# We have a conf and classes directory, add to BBPATH
BBPATH .= ":${LAYERDIR}"

# We have recipes-* directories, add to BBFILES
BBFILES += "${LAYERDIR}/recipes-*/*/*.bb \
            ${LAYERDIR}/recipes-*/*/*.bbappend"

BBFILE_COLLECTIONS += "meta-hailo-libhailort"
BBFILE_PATTERN_meta-hailo-libhailort = "^${LAYERDIR}/"
BBFILE_PRIORITY_meta-hailo-libhailort = "8"

LICENSE_PATH = "${LAYERDIR}/licenses/"

LAYERDEPENDS_meta-hailo-libhailort = "core"
LAYERSERIES_COMPAT_meta-hailo-libhailort = "honister"
```

## PetaLinux/bsp/zcu106/project-spec/meta-user/meta-hailo/meta-hailo-tappas/conf/layer.conf
```bitbake
# We have a conf and classes directory, add to BBPATH
BBPATH .= ":${LAYERDIR}"

# We have recipes-* directories, add to BBFILES
BBFILES += "${LAYERDIR}/recipes-*/*/*.bb \
            ${LAYERDIR}/recipes-*/*/*.bbappend"

BBFILE_COLLECTIONS += "meta-hailo-tappas"
BBFILE_PATTERN_meta-hailo-tappas = "^${LAYERDIR}/"
BBFILE_PRIORITY_meta-hailo-tappas = "8"

LICENSE_PATH = "${LAYERDIR}/licenses/"

LAYERDEPENDS_meta-hailo-tappas = "core meta-hailo-libhailort"
LAYERSERIES_COMPAT_meta-hailo-tappas = "honister"
```
